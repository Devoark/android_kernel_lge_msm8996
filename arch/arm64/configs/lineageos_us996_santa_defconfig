## arch/arm64/configs/lineageos_us996_santa_defconfig
```kconfig
include lineageos_elsa_common
# LG Platform
#adding Santa for US996 santa for static screen
CONFIG_MACH_MSM8996_ELSA_NAO_US_SANTA=y

# Broadcom - Wifi
CONFIG_BCMDHD=y
CONFIG_BCMDHD_LEGACY=y
CONFIG_BCMDHD_PCIE=y
CONFIG_BCM4358=y
CONFIG_BCMDHD_COB=y
CONFIG_BCMDHD_USE_SCHED_SCAN=y
CONFIG_BCMDHD_FOLLOW_AP_DTIM_PERIOD=n
CONFIG_WIFI_CONTROL_FUNC=y
```
